## meta-cmf-ipq/conf/layer.conf
```bitbake
BBPATH .= ":${LAYERDIR}"
BBFILES += "\
            ${LAYERDIR}/recipes-*/*/*.bb \
            ${LAYERDIR}/recipes-*/*/*.bbappend \
           "

BBFILE_COLLECTIONS += "cmf-ipq"
BBFILE_PATTERN_cmf-ipq = "^${LAYERDIR}/"
BBFILE_PRIORITY_cmf-ipq = "7"

LAYERSERIES_COMPAT_cmf-ipq = "dunfell kirkstone"

#DISTRO_FEATURES_append = " parodus"
require conf/distro/include/rdk-ipq.inc
```

## meta-cmf-ipq/conf/machine/ipq53xx-rdk-broadband.conf
```bitbake
#@TYPE: Machine
#@NAME: ipq53xx-rdk-broadband
#@RDK_FLAVOR: rdkb
#@NEEDED_BSPLAYERS: meta-rdk-qcom/meta-cmf-ipq
#@DESCRIPTION: Machine configuration for running a RDK broadband on IPQ807x

require conf/machine/ipq53xx.conf

#set platform type (broadband, hybrid, or client)
MACHINEOVERRIDES .= ":ipq53xx:ipq:broadband"
MACHINE_IMAGE_NAME = "ipq53xx-rdk-broadband-image"

IMAGE_FSTYPES_DEBUGFS = "tar.gz"
# PREFERRED_VERSION_bridge-utils = "1.5"
PREFERRED_VERSION_ppp = "2.4.7"
PREFERRED_VERSION_linux-ipq ?= "5.4%"
R = "${IMAGE_ROOTFS}"

RELEASE_VERSION = "${REVISION}"
BBMASK .= "|meta-linaro/recipes-kernel"
BBMASK .= "|meta-rdk/recipes-support/base64"
BBMASK .= "|meta-ipq/recipes-packages/dnsmasq"
BBMASK .= "|meta-ipq/recipes-packages/libubox"
BBMASK .= "|meta-ipq/recipes-packages/uci"
BBMASK .= "|meta-rdk-ext/recipes-core/volatile-binds/"
VOLATILE_BINDS_append = "/var/volatile/lib /var/lib\n"
INCOMPATIBLE_LICENSE = "GPLv3.0 GPLv3 GPL-3.0 GPLv3+ LGPLv3.0 LGPLv3 LGPL-3.0 LGPLv3+"

# Define GPLv3 exceptions for debug tools
DEBUG_GPLV3_EXCEPTIONS = " ${MLPREFIX}gdb:GPL-3.0-only ${MLPREFIX}gdb:LGPL-3.0-only ${MLPREFIX}binutils:GPL-3.0-only ${MLPREFIX}libbfd:GPL-3.0-only ${MLPREFIX}libopcodes:GPL-3.0-only"
INCOMPATIBLE_LICENSE_EXCEPTIONS_append = "${@bb.utils.contains('DISTRO_FEATURES', 'debug_gplv3_tools', '${DEBUG_GPLV3_EXCEPTIONS}', '', d)}"

# RDEPENDS_packagegroup-rdk-ccsp-broadband_remove = "rdkgponmanager"
```

## meta-cmf-ipq/conf/machine/ipq53xx_64-rdk-broadband.conf
```bitbake
#@TYPE: Machine
#@NAME: ipq53xx_64-rdk-broadband
#@RDK_FLAVOR: rdkb
#@NEEDED_BSPLAYERS: meta-rdk-qcom/meta-cmf-ipq
#@DESCRIPTION: Machine configuration for running a RDK broadband on IPQ807x

require conf/machine/ipq53xx_64.conf

#set platform type (broadband, hybrid, or client)
MACHINEOVERRIDES .= ":ipq53xx-64:ipq53xx_64:ipq:broadband"
MACHINE_IMAGE_NAME = "ipq53xx_64-rdk-broadband-image"
DISTRO_FEATURES_append = " dslite"

IMAGE_FSTYPES_DEBUGFS = "tar.gz"
# PREFERRED_VERSION_bridge-utils = "1.5"
PREFERRED_VERSION_ppp = "2.4.7"
PREFERRED_VERSION_linux-ipq ?= "5.4%"
R = "${IMAGE_ROOTFS}"

RELEASE_VERSION = "${REVISION}"
BBMASK .= "|meta-linaro/recipes-kernel"
BBMASK .= "|meta-rdk/recipes-support/base64"
BBMASK .= "|meta-ipq/recipes-packages/dnsmasq"
BBMASK .= "|meta-ipq/recipes-packages/libubox"
BBMASK .= "|meta-ipq/recipes-packages/uci"
BBMASK .= "|meta-rdk-ext/recipes-core/volatile-binds/"
VOLATILE_BINDS_append = "/var/volatile/lib /var/lib\n"
INCOMPATIBLE_LICENSE = "GPLv3.0 GPLv3 GPL-3.0 GPLv3+ LGPLv3.0 LGPLv3 LGPL-3.0 LGPLv3+"
```

## meta-cmf-ipq/conf/machine/ipq53xx_64-rdk-extender.conf
```bitbake
#@TYPE: Machine
#@NAME: ipq53xx_64-rdk-broadband
#@RDK_FLAVOR: rdkb
#@NEEDED_BSPLAYERS: meta-rdk-qcom/meta-cmf-ipq
#@DESCRIPTION: Machine configuration for running a RDK broadband on IPQ53xx

require conf/machine/ipq53xx_64.conf
require conf/include/rdkb-extender-platform-bbmasks.inc

#set platform type (broadband, hybrid, or client)
MACHINEOVERRIDES .= ":ipq53xx-64:ipq53xx_64:ipq:broadband"
MACHINE_IMAGE_NAME = "ipq53xx_64-rdk-broadband-image"

IMAGE_FSTYPES_DEBUGFS = "tar.gz"
# PREFERRED_VERSION_bridge-utils = "1.5"
PREFERRED_VERSION_ppp = "2.4.9"
PREFERRED_VERSION_lua = "5.3.5"
PREFERRED_VERSION_libnl_kirkstone ?= "3.5.0"
PREFERRED_VERSION_jansson_kirkstone = "2.13.1"
PREFERRED_VERSION_googletest_kirkstone = "1.11.%"
PREFERRED_VERSION_net-snmp_kirkstone = "5.9.1"
PREFERRED_VERSION_icu_kirkstone ?= "70.1"
PREFERRED_VERSION_icu-native_kirkstone ?= "70.1"
PREFERRED_VERSION_python3-markupsafe_kirkstone = "1.1.1"
PREFERRED_VERSION_linux-ipq ?= "6.6%"
PREFERRED_VERSION_dbus = "1.12.16"

#preferred version for meson
PREFERRED_VERSION_meson-native_kirkstone = "0.61.3"
PREFERRED_VERSION_meson_kirkstone = "0.61.3"

R = "${IMAGE_ROOTFS}"

#Kirkstone specific
DISTRO_FEATURES_append = " kirkstone"
DISTRO_FEATURES_NATIVE_append = " kirkstone"
DISTRO_FEATURES_NATIVESDK_append = " kirkstone"
MACHINEOVERRIDES .= ":kirkstone"
DISTRO_FEATURES_append = " kirkstone-image"

#enable core-net-lib
DISTRO_FEATURES_append = " core-net-lib"

#RELEASE_VERSION = "${REVISION}"
BBMASK .= "|meta-linaro/recipes-kernel"
BBMASK .= "|meta-rdk/recipes-support/base64"
BBMASK .= "|meta-ipq/recipes-packages/dnsmasq"
BBMASK .= "|meta-ipq/recipes-packages/libubox"
BBMASK .= "|meta-ipq/recipes-packages/uci"
BBMASK .= "|meta-rdk-ext/recipes-core/volatile-binds/"
VOLATILE_BINDS_append = "/var/volatile/lib /var/lib\n"
INCOMPATIBLE_LICENSE = "GPLv3.0 GPLv3 GPL-3.0 GPLv3+ LGPLv3.0 LGPLv3 LGPL-3.0 LGPLv3+"

# Define GPLv3 exceptions for debug tools
DEBUG_GPLV3_EXCEPTIONS = " ${MLPREFIX}gdb:GPL-3.0-only ${MLPREFIX}gdb:LGPL-3.0-only ${MLPREFIX}binutils:GPL-3.0-only ${MLPREFIX}libbfd:GPL-3.0-only ${MLPREFIX}libopcodes:GPL-3.0-only"
INCOMPATIBLE_LICENSE_EXCEPTIONS_append = "${@bb.utils.contains('DISTRO_FEATURES', 'debug_gplv3_tools', '${DEBUG_GPLV3_EXCEPTIONS}', '', d)}"

DISTRO_FEATURES_append = " extender "

#conf version
CONF_VERSION = "1"
```

## meta-cmf-ipq/conf/machine/ipq807x-rdk-broadband.conf
```bitbake
#@TYPE: Machine
#@NAME: ipq807x-rdk-broadband
#@RDK_FLAVOR: rdkb
#@NEEDED_BSPLAYERS: meta-rdk-qcom/meta-cmf-ipq
#@DESCRIPTION: Machine configuration for running a RDK broadband on IPQ807x

require conf/machine/ipq807x.conf

#set platform type (broadband, hybrid, or client)
MACHINEOVERRIDES .= ":ipq807x:ipq:broadband"
MACHINE_IMAGE_NAME = "ipq807x-rdk-broadband-image"

IMAGE_FSTYPES_DEBUGFS = "tar.gz"
# PREFERRED_VERSION_bridge-utils = "1.5"
PREFERRED_VERSION_ppp = "2.4.7"
PREFERRED_VERSION_linux-ipq ?= "5.4%"
R = "${IMAGE_ROOTFS}"

RELEASE_VERSION = "${REVISION}"
BBMASK .= "|meta-linaro/recipes-kernel"
BBMASK .= "|meta-rdk/recipes-support/base64"
BBMASK .= "|meta-ipq/recipes-packages/dnsmasq"
BBMASK .= "|meta-ipq/recipes-packages/libubox"
BBMASK .= "|meta-rdk-ext/recipes-core/volatile-binds/"
VOLATILE_BINDS_append = "/var/volatile/lib /var/lib\n"
INCOMPATIBLE_LICENSE = "GPLv3.0 GPLv3 GPL-3.0 GPLv3+ LGPLv3.0 LGPLv3 LGPL-3.0 LGPLv3+"
```

## meta-cmf-ipq/conf/machine/ipq807x_64-rdk-broadband.conf
```bitbake
#@TYPE: Machine
#@NAME: ipq807x_64-rdk-broadband
#@RDK_FLAVOR: rdkb
#@NEEDED_BSPLAYERS: meta-rdk-qcom/meta-cmf-ipq
#@DESCRIPTION: Machine configuration for running a RDK broadband on IPQ807x_64

require conf/machine/ipq807x_64.conf

#set platform type (broadband, hybrid, or client)
MACHINEOVERRIDES .= ":ipq807x-64:ipq807x_64:ipq:broadband"
MACHINE_IMAGE_NAME = "ipq807x_64-rdk-broadband-image"
DISTRO_FEATURES_append = " dslite"

IMAGE_FSTYPES_DEBUGFS = "tar.gz"
# PREFERRED_VERSION_bridge-utils = "1.5"
PREFERRED_VERSION_ppp = "2.4.7"
PREFERRED_VERSION_linux-ipq ?= "5.4%"
R = "${IMAGE_ROOTFS}"

RELEASE_VERSION = "${REVISION}"
BBMASK .= "|meta-linaro/recipes-kernel"
BBMASK .= "|meta-rdk/recipes-support/base64"
BBMASK .= "|meta-ipq/recipes-packages/dnsmasq"
BBMASK .= "|meta-ipq/recipes-packages/libubox"
BBMASK .= "|meta-rdk-ext/recipes-core/volatile-binds/"
VOLATILE_BINDS_append = "/var/volatile/lib /var/lib\n"
INCOMPATIBLE_LICENSE = "GPLv3.0 GPLv3 GPL-3.0 GPLv3+ LGPLv3.0 LGPLv3 LGPL-3.0 LGPLv3+"

# Define GPLv3 exceptions for debug tools
DEBUG_GPLV3_EXCEPTIONS = " ${MLPREFIX}gdb:GPL-3.0-only ${MLPREFIX}gdb:LGPL-3.0-only ${MLPREFIX}binutils:GPL-3.0-only ${MLPREFIX}libbfd:GPL-3.0-only ${MLPREFIX}libopcodes:GPL-3.0-only"
INCOMPATIBLE_LICENSE_EXCEPTIONS_append = "${@bb.utils.contains('DISTRO_FEATURES', 'debug_gplv3_tools', '${DEBUG_GPLV3_EXCEPTIONS}', '', d)}"
```
